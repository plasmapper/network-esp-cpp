## examples/tcp_ota_server/sdkconfig.defaults
```kconfig
CONFIG_COMPILER_CXX_RTTI=y
CONFIG_LOG_DEFAULT_LEVEL_ERROR=y
CONFIG_LOG_DEFAULT_LEVEL=1
CONFIG_LOG_MAXIMUM_LEVEL=1
CONFIG_LWIP_SO_RCVBUF=y
CONFIG_ESP32_WIFI_NVS_ENABLED=n
CONFIG_PARTITION_TABLE_TWO_OTA=y
CONFIG_BOOTLOADER_APP_ROLLBACK_ENABLE=y
CONFIG_ESPTOOLPY_FLASHSIZE_4MB=y
```
